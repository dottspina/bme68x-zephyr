## drivers/bme68x-sensor-api/Kconfig
```kconfig
# Copyright (c) 2024, Chris Duf
#
# SPDX-License-Identifier: Apache-2.0

menuconfig BME68X_SENSOR_API_DRIVER
	bool "BME68X Sensor API (Driver)"
	default y if DT_HAS_BOSCH_BME68X_SENSOR_API_ENABLED
	select BME68X_SENSOR_API
	select I2C if $(dt_compat_on_bus,$(DT_COMPAT_BOSCH_BME68X_SENSOR_API),i2c)
	select SPI if $(dt_compat_on_bus,$(DT_COMPAT_BOSCH_BME68X_SENSOR_API),spi)
	help
	  Bosch Sensortec BME68X Sensor API integration with Zephyr-RTOS.

	  Bind Zephyr devices with "bosch,bme68x-sensor-api" bindings
	  to BME68X Sensor API sensors.

if BME68X_SENSOR_API_DRIVER

config BME68X_SENSOR_API_DRIVER_INIT_PRIORITY
	int "Relative initialization priority"
	default 99
	help
	   Within each initialization level you may specify a priority level,
 	   relative to other devices in the same initialization level.
 	   The priority level is specified as an integer value in the range 0 to 99;
 	   lower values indicate earlier initialization.

choice BME68X_SENSOR_API_DRIVER_LOG_LEVEL_CHOICE
	prompt "Max compiled-in log level"
	default BME68X_SENSOR_API_DRIVER_LOG_LEVEL_DEFAULT
	depends on LOG

config BME68X_SENSOR_API_DRIVER_LOG_LEVEL_OFF
	bool "Off"
config BME68X_SENSOR_API_DRIVER_LOG_LEVEL_ERR
	bool "Error"
config BME68X_SENSOR_API_DRIVER_LOG_LEVEL_WRN
	bool "Warning"
config BME68X_SENSOR_API_DRIVER_LOG_LEVEL_INF
	bool "Info"
config BME68X_SENSOR_API_DRIVER_LOG_LEVEL_DBG
	bool "Debug"
config BME68X_SENSOR_API_DRIVER_LOG_LEVEL_DEFAULT
	bool "Default"

endchoice

config BME68X_SENSOR_API_DRIVER_LOG_LEVEL
	int
	depends on LOG
	default 0 if BME68X_SENSOR_API_DRIVER_LOG_LEVEL_OFF
	default 1 if BME68X_SENSOR_API_DRIVER_LOG_LEVEL_ERR
	default 2 if BME68X_SENSOR_API_DRIVER_LOG_LEVEL_WRN
	default 3 if BME68X_SENSOR_API_DRIVER_LOG_LEVEL_INF
	default 4 if BME68X_SENSOR_API_DRIVER_LOG_LEVEL_DBG
	default LOG_DEFAULT_LEVEL if BME68X_SENSOR_API_DRIVER_LOG_LEVEL_DEFAULT

endif # BME68X_SENSOR_API_DRIVER
```

## dts/bindings/bosch,bme68x-sensor-api-spi.yaml
```yaml
# Copyright (c) 2024, Chris Duf
# SPDX-License-Identifier: Apache-2.0

description: |
    BME680/688 are integrated environmental sensors that measure
    temperature, pressure, humidity and air quality.

    Compatible devices support Bosch Sensortec's BME68X Sensor API
    instead of Zephyr Sensor API.

compatible: "bosch,bme68x-sensor-api"

include: [sensor-device.yaml, spi-device.yaml]
```

## lib/Kconfig
```kconfig
# SPDX-License-Identifier: Apache-2.0

rsource "bme68x-sensor-api/Kconfig"
rsource "bsec/Kconfig"
rsource "bme68x-iaq/Kconfig"
rsource "bme68x-esp/Kconfig"
```

## lib/bme68x-esp/Kconfig
```kconfig
# Copyright (c) 2025, Chris Duf
#
# SPDX-License-Identifier: Apache-2.0

menuconfig BME68X_ESP
	bool "Environmental Sensing Profile"
	depends on BT_PERIPHERAL
	help
	  Enable Bluetooth Environmental Sensing Profile (ESP).

	  Will automatically enable the Environmental Sensing Service (ESS):
	  - supports the Temperature, Pressure and Humidity ESS characteristics
	  - for each characteristic, notifications are configured with
	    an ES Trigger Setting descriptor;

	  By default, characteristic values are notified to subscribed clients
	  "when the value changes compared to previous value",
	  and ES Trigger Setting descriptors cannot be modified by connected centrals.


if BME68X_ESP

config BME68X_ESP_GAP_ADV_AUTO
	bool "Automatically resume advertising"
	default y
	help
	  Automatically resume advertising
	  whenever a connection resource is available.

choice BME68X_ES_TRIGGER_SETTINGS_PERM
	prompt "Allow clients to reconfigure notifications"
	default BME68X_ES_TRIGGER_SETTINGS_READ
	help
	  Whether connected centrals can write to ES Trigger Setting descriptors.
	  By default, ES Trigger Setting descriptors are read-only.

config BME68X_ES_TRIGGER_SETTINGS_READ
	bool "Never"
	help
	  All ES Trigger Setting descriptors are read-only.

config BME68X_ES_TRIGGER_SETTINGS_WRITE
	bool "Always"
	help
	  Any connected central can write to all ES Trigger Setting descriptors.

	  To limit write access to encrypted or authenticated connections,
	  first enable the Security Manager Protocol (BT_SMP).

config BME68X_ES_TRIGGER_SETTINGS_WRITE_ENCRYPT
	bool "Encrypted connections"
	depends on BT_SMP
	help
	  ES Trigger Setting descriptors are writable only
	  over encrypted connections.

config BME68X_ES_TRIGGER_SETTINGS_WRITE_AUTHEN
	bool "Authenticated connections"
	depends on BT_SMP
	help
	  ES Trigger Setting descriptors are writable only
	  over authenticated connections.

endchoice # BME68X_ES_TRIGGER_SETTINGS_PERM


menu "Temperature notifications"

choice BME68X_TEMPERATURE_TRIGGER_CONDITION
	prompt "Condition"
	default BME68X_TEMPERATURE_TRIGGER_VALUE_CHANGED

config BME68X_TEMPERATURE_TRIGGER_INACTIVE
	bool "Disabled"

config BME68X_TEMPERATURE_TRIGGER_FIXED_TIME
	bool "Use a fixed time interval between transmissions"

config BME68X_TEMPERATURE_TRIGGER_GTE_TIME
	bool "No less than the specified time between transmissions"

config BME68X_TEMPERATURE_TRIGGER_VALUE_CHANGED
	bool "When value changes compared to previous value"

config BME68X_TEMPERATURE_TRIGGER_LT_VALUE
	bool "While less than the specified value"

config BME68X_TEMPERATURE_TRIGGER_LTE_VALUE
	bool "While less than or equal to the specified value"

config BME68X_TEMPERATURE_TRIGGER_GT_VALUE
	bool "While greater than the specified value"

config BME68X_TEMPERATURE_TRIGGER_GTE_VALUE
	bool "While greater than or equal to the specified value"

config BME68X_TEMPERATURE_TRIGGER_VALUE
	bool "While equal to the specified value"

config BME68X_TEMPERATURE_TRIGGER_NOT_VALUE
	bool "While not equal to the specified value"

endchoice # BME68X_TEMPERATURE_TRIGGER_CONDITION
config BME68X_TEMPERATURE_TRIGGER_CONDITION
	int
	default 0 if BME68X_TEMPERATURE_TRIGGER_INACTIVE
	default 1 if BME68X_TEMPERATURE_TRIGGER_FIXED_TIME
	default 2 if BME68X_TEMPERATURE_TRIGGER_GTE_TIME
	default 3 if BME68X_TEMPERATURE_TRIGGER_VALUE_CHANGED
	default 4 if BME68X_TEMPERATURE_TRIGGER_LT_VALUE
	default 5 if BME68X_TEMPERATURE_TRIGGER_LTE_VALUE
	default 6 if BME68X_TEMPERATURE_TRIGGER_GT_VALUE
	default 7 if BME68X_TEMPERATURE_TRIGGER_GTE_VALUE
	default 8 if BME68X_TEMPERATURE_TRIGGER_VALUE
	default 9 if BME68X_TEMPERATURE_TRIGGER_NOT_VALUE

config BME68X_TEMPERATURE_TRIGGER_SECONDS
	int "Seconds"
	depends on BME68X_TEMPERATURE_TRIGGER_FIXED_TIME || \
		BME68X_TEMPERATURE_TRIGGER_GTE_TIME
	default 30

config BME68X_TEMPERATURE_TRIGGER_TEMPERATURE
	int "Value (Celsius x 100)"
	depends on BME68X_TEMPERATURE_TRIGGER_LT_VALUE || \
		BME68X_TEMPERATURE_TRIGGER_LTE_VALUE || \
		BME68X_TEMPERATURE_TRIGGER_GT_VALUE  || \
		BME68X_TEMPERATURE_TRIGGER_GTE_VALUE || \
		BME68X_TEMPERATURE_TRIGGER_VALUE     || \
		BME68X_TEMPERATURE_TRIGGER_NOT_VALUE
	default 2000

config BME68X_TEMPERATURE_TRIGGER_OPERAND
	int
	# Time-based conditions operand.
	default BME68X_TEMPERATURE_TRIGGER_SECONDS \
		if BME68X_TEMPERATURE_TRIGGER_FIXED_TIME \
		|| BME68X_TEMPERATURE_TRIGGER_GTE_TIME
	# Value-based conditions operand.
	default BME68X_TEMPERATURE_TRIGGER_TEMPERATURE \
		if BME68X_TEMPERATURE_TRIGGER_LT_VALUE || \
		BME68X_TEMPERATURE_TRIGGER_LTE_VALUE || \
		BME68X_TEMPERATURE_TRIGGER_GT_VALUE  || \
		BME68X_TEMPERATURE_TRIGGER_GTE_VALUE || \
		BME68X_TEMPERATURE_TRIGGER_VALUE     || \
		BME68X_TEMPERATURE_TRIGGER_NOT_VALUE
	# Set a default value for conditions without operand.
	default 0
endmenu # Temperature Trigger Setting

menu "Pressure notifications"
choice BME68X_PRESSURE_TRIGGER_CONDITION
	prompt "Condition"
	default BME68X_PRESSURE_TRIGGER_VALUE_CHANGED

config BME68X_PRESSURE_TRIGGER_INACTIVE
	bool "Disabled"

config BME68X_PRESSURE_TRIGGER_FIXED_TIME
	bool "Use a fixed time interval between transmissions"

config BME68X_PRESSURE_TRIGGER_GTE_TIME
	bool "No less than the specified time between transmissions"

config BME68X_PRESSURE_TRIGGER_VALUE_CHANGED
	bool "When value changes compared to previous value"

config BME68X_PRESSURE_TRIGGER_LT_VALUE
	bool "While less than the specified value"

config BME68X_PRESSURE_TRIGGER_LTE_VALUE
	bool "While less than or equal to the specified value"

config BME68X_PRESSURE_TRIGGER_GT_VALUE
	bool "While greater than the specified value"

config BME68X_PRESSURE_TRIGGER_GTE_VALUE
	bool "While greater than or equal to the specified value"

config BME68X_PRESSURE_TRIGGER_VALUE
	bool "While equal to the specified value"

config BME68X_PRESSURE_TRIGGER_NOT_VALUE
	bool "While not equal to the specified value"

endchoice # BME68X_PRESSURE_TRIGGER_CONDITION
config BME68X_PRESSURE_TRIGGER_CONDITION
	int
	default 0 if BME68X_PRESSURE_TRIGGER_INACTIVE
	default 1 if BME68X_PRESSURE_TRIGGER_FIXED_TIME
	default 2 if BME68X_PRESSURE_TRIGGER_GTE_TIME
	default 3 if BME68X_PRESSURE_TRIGGER_VALUE_CHANGED
	default 4 if BME68X_PRESSURE_TRIGGER_LT_VALUE
	default 5 if BME68X_PRESSURE_TRIGGER_LTE_VALUE
	default 6 if BME68X_PRESSURE_TRIGGER_GT_VALUE
	default 7 if BME68X_PRESSURE_TRIGGER_GTE_VALUE
	default 8 if BME68X_PRESSURE_TRIGGER_VALUE
	default 9 if BME68X_PRESSURE_TRIGGER_NOT_VALUE

config BME68X_PRESSURE_TRIGGER_SECONDS
	int "Seconds"
	depends on BME68X_PRESSURE_TRIGGER_FIXED_TIME || \
		BME68X_PRESSURE_TRIGGER_GTE_TIME
	default 30

config BME68X_PRESSURE_TRIGGER_PRESSURE
	int "Value (Pascal x 10)"
	depends on BME68X_PRESSURE_TRIGGER_LT_VALUE || \
		BME68X_PRESSURE_TRIGGER_LTE_VALUE || \
		BME68X_PRESSURE_TRIGGER_GT_VALUE  || \
		BME68X_PRESSURE_TRIGGER_GTE_VALUE || \
		BME68X_PRESSURE_TRIGGER_VALUE     || \
		BME68X_PRESSURE_TRIGGER_NOT_VALUE
	default 1000000

config BME68X_PRESSURE_TRIGGER_OPERAND
	int
	# Time-based conditions operand.
	default BME68X_PRESSURE_TRIGGER_SECONDS \
		if BME68X_PRESSURE_TRIGGER_FIXED_TIME \
		|| BME68X_PRESSURE_TRIGGER_GTE_TIME
	# Value-based conditions operand.
	default BME68X_PRESSURE_TRIGGER_PRESSURE \
		if BME68X_PRESSURE_TRIGGER_LT_VALUE || \
		BME68X_PRESSURE_TRIGGER_LTE_VALUE || \
		BME68X_PRESSURE_TRIGGER_GT_VALUE  || \
		BME68X_PRESSURE_TRIGGER_GTE_VALUE || \
		BME68X_PRESSURE_TRIGGER_VALUE     || \
		BME68X_PRESSURE_TRIGGER_NOT_VALUE
	# Set a default value for conditions without operand.
	default 0
endmenu # Pressure Trigger Setting

menu "Humidity notifications"
choice BME68X_HUMIDITY_TRIGGER_CONDITION
	prompt "Condition"
	default BME68X_HUMIDITY_TRIGGER_VALUE_CHANGED

config BME68X_HUMIDITY_TRIGGER_INACTIVE
	bool "Disabled"

config BME68X_HUMIDITY_TRIGGER_FIXED_TIME
	bool "Use a fixed time interval between transmissions"

config BME68X_HUMIDITY_TRIGGER_GTE_TIME
	bool "No less than the specified time between transmissions"

config BME68X_HUMIDITY_TRIGGER_VALUE_CHANGED
	bool "When value changes compared to previous value"

config BME68X_HUMIDITY_TRIGGER_LT_VALUE
	bool "While less than the specified value"

config BME68X_HUMIDITY_TRIGGER_LTE_VALUE
	bool "While less than or equal to the specified value"

config BME68X_HUMIDITY_TRIGGER_GT_VALUE
	bool "While greater than the specified value"

config BME68X_HUMIDITY_TRIGGER_GTE_VALUE
	bool "While greater than or equal to the specified value"

config BME68X_HUMIDITY_TRIGGER_VALUE
	bool "While equal to the specified value"

config BME68X_HUMIDITY_TRIGGER_NOT_VALUE
	bool "While not equal to the specified value"

endchoice # BME68X_HUMIDITY_TRIGGER_CONDITION
config BME68X_HUMIDITY_TRIGGER_CONDITION
	int
	default 0 if BME68X_HUMIDITY_TRIGGER_INACTIVE
	default 1 if BME68X_HUMIDITY_TRIGGER_FIXED_TIME
	default 2 if BME68X_HUMIDITY_TRIGGER_GTE_TIME
	default 3 if BME68X_HUMIDITY_TRIGGER_VALUE_CHANGED
	default 4 if BME68X_HUMIDITY_TRIGGER_LT_VALUE
	default 5 if BME68X_HUMIDITY_TRIGGER_LTE_VALUE
	default 6 if BME68X_HUMIDITY_TRIGGER_GT_VALUE
	default 7 if BME68X_HUMIDITY_TRIGGER_GTE_VALUE
	default 8 if BME68X_HUMIDITY_TRIGGER_VALUE
	default 9 if BME68X_HUMIDITY_TRIGGER_NOT_VALUE

config BME68X_HUMIDITY_TRIGGER_SECONDS
	int "Seconds"
	depends on BME68X_HUMIDITY_TRIGGER_FIXED_TIME || \
		BME68X_HUMIDITY_TRIGGER_GTE_TIME
	default 30

config BME68X_HUMIDITY_TRIGGER_HUMIDITY
	int "Value (Percent x 100)"
	depends on BME68X_HUMIDITY_TRIGGER_LT_VALUE || \
		BME68X_HUMIDITY_TRIGGER_LTE_VALUE || \
		BME68X_HUMIDITY_TRIGGER_GT_VALUE  || \
		BME68X_HUMIDITY_TRIGGER_GTE_VALUE || \
		BME68X_HUMIDITY_TRIGGER_VALUE     || \
		BME68X_HUMIDITY_TRIGGER_NOT_VALUE
	default 6000

config BME68X_HUMIDITY_TRIGGER_OPERAND
	int
	# Time-based conditions operand.
	default BME68X_HUMIDITY_TRIGGER_SECONDS \
		if BME68X_HUMIDITY_TRIGGER_FIXED_TIME \
		|| BME68X_HUMIDITY_TRIGGER_GTE_TIME
	# Value-based conditions operand.
	default BME68X_HUMIDITY_TRIGGER_HUMIDITY \
		if BME68X_HUMIDITY_TRIGGER_LT_VALUE || \
		BME68X_HUMIDITY_TRIGGER_LTE_VALUE || \
		BME68X_HUMIDITY_TRIGGER_GT_VALUE  || \
		BME68X_HUMIDITY_TRIGGER_GTE_VALUE || \
		BME68X_HUMIDITY_TRIGGER_VALUE     || \
		BME68X_HUMIDITY_TRIGGER_NOT_VALUE
	# Set a default value for conditions without operand.
	default 0
endmenu # Humidity Trigger Setting


choice BME68X_ESP_LOG_LEVEL_CHOICE
	prompt "Max compiled-in log level"
	default BME68X_ESP_LOG_LEVEL_DEFAULT
	depends on LOG

config BME68X_ESP_LOG_LEVEL_OFF
	bool "Off"
config BME68X_ESP_LOG_LEVEL_ERR
	bool "Error"
config BME68X_ESP_LOG_LEVEL_WRN
	bool "Warning"
config BME68X_ESP_LOG_LEVEL_INF
	bool "Info"
config BME68X_ESP_LOG_LEVEL_DBG
	bool "Debug"
config BME68X_ESP_LOG_LEVEL_DEFAULT
	bool "Default"
endchoice

config BME68X_ESP_LOG_LEVEL
	int
	depends on LOG
	default 0 if BME68X_ESP_LOG_LEVEL_OFF
	default 1 if BME68X_ESP_LOG_LEVEL_ERR
	default 2 if BME68X_ESP_LOG_LEVEL_WRN
	default 3 if BME68X_ESP_LOG_LEVEL_INF
	default 4 if BME68X_ESP_LOG_LEVEL_DBG
	default LOG_DEFAULT_LEVEL if BME68X_ESP_LOG_LEVEL_DEFAULT

endif # BME68X_ESP
```
