## lib/bme68x-iaq/Kconfig
```kconfig
# Copyright (c) 2024, Chris Duf
#
# SPDX-License-Identifier: Apache-2.0

menuconfig BME68X_IAQ
	bool "Support library for BSEC IAQ"
	depends on BSEC
	depends on BME68X_SENSOR_API
	help
	  Enable support library for Index for Air Quality (IAQ)
	  with Bosch Sensortec Environmental Cluster (BSEC)
	  and the BME68X Sensor API.

if BME68X_IAQ

config BME68X_IAQ_AMBIENT_TEMP
	int "Expected ambient temperature"
	default 20
	help
	  Initial ambient temperature used to computer heater resistance
	  in degree Celsius.

config BME68X_IAQ_SETTINGS
	bool "BSEC state persistence (Settings)"
	depends on SETTINGS
	help
	  Enable support for BSEC state persistence to per-device settings.

	  When enabled, the library will:
	  - on initialization, try to load a saved BSEC state,
	    or reset any previously saved state if BME68X_IAQ_RST_SAVED_STATE is set
	  - periodically update the saved BSEC state,
	    according to BME68X_IAQ_STATE_SAVE_INTVL

config BME68X_IAQ_STATE_SAVE_INTVL
	int "BSEC state save interval"
	depends on BME68X_IAQ_SETTINGS
	default 1140
	help
	  When the BSEC state persistence enabled,
	  this library's IAQ control loop will periodically
	  save the BSEC algorithm state to flash memory.

	  This is the periodicity in minutes,
	  e.g. 1440 to save the algorithm state once a day.

	  Set this option to zero to disable periodic BSEC state persistence.

config BME68X_IAQ_RST_SAVED_STATE
	bool "Reset saved BSEC state"
	depends on BME68X_IAQ_SETTINGS
	help
	  Delete BSEC state from per-device settings during system reset.

config BME68X_IAQ_NVS
	bool "BSEC state persistence (NVS)"
	depends on NVS
	help
	  Enable support for BSEC state persistence to Flash storage with NVS.

	  Build API for BSEC state persistence to NVS.

	  See also: BME68X_IAQ_SETTINGS

menu "IAQ configuration"

choice
	prompt "Sample rate"
	default BME68X_IAQ_SAMPLE_RATE_LP
	help
	  BSEC sensors sample rate.

	config BME68X_IAQ_SAMPLE_RATE_LP
		bool "1/3 Hz (LP)"
		help
		  Low Power mode.

	  	  Low power (LP) mode is designed for interactive applications
	  	  where the air quality is tracked and observed at a higher update rate
	  	  of 3 seconds with a current consumption of <1 mA.


	config BME68X_IAQ_SAMPLE_RATE_ULP
		bool "1/300 Hz (ULP)"
		help
		  Ultra Low Power mode.

	  	  Ultra low power (ULP) mode is designed for battery-powered and/or
	  	  frequency-coupled devices over extended periods of time.
		  This mode features an update rate of 300 seconds
	  	  and an average current consumption of <0.1 mA.

endchoice
config BME68X_IAQ_SAMPLE_RATE
	 string
	 default "300s" if BME68X_IAQ_SAMPLE_RATE_ULP
	 default "3s" if BME68X_IAQ_SAMPLE_RATE_LP

choice
	prompt "Supply voltage"
	default BME68X_IAQ_33V

config BME68X_IAQ_33V
	bool "3.3 V"
config BME68X_IAQ_18V
	bool "1.8 V"

endchoice # "Supply voltage"
config BME68X_IAQ_VDD
	 string
	 default "33v" if BME68X_IAQ_33V
	 default "18v" if BME68X_IAQ_18V

choice
	prompt "Calibration time"
	default BME68X_IAQ_4D

config BME68X_IAQ_4D
	bool "4 days"
config BME68X_IAQ_28D
	bool "28 days"

endchoice # "Calibrarion time"
config BME68X_IAQ_CALIB_TIME
	 string
	 default "4d" if BME68X_IAQ_4D
	 default "28d" if BME68X_IAQ_28D

endmenu # "IAQ configuration"

choice BME68X_IAQ_LOG_LEVEL_CHOICE
	prompt "Max compiled-in log level"
	default BME68X_IAQ_LOG_LEVEL_DEFAULT
	depends on LOG

config BME68X_IAQ_LOG_LEVEL_OFF
	bool "Off"

config BME68X_IAQ_LOG_LEVEL_ERR
	bool "Error"

config BME68X_IAQ_LOG_LEVEL_WRN
	bool "Warning"

config BME68X_IAQ_LOG_LEVEL_INF
	bool "Info"

config BME68X_IAQ_LOG_LEVEL_DBG
	bool "Debug"

config BME68X_IAQ_LOG_LEVEL_DEFAULT
	bool "Default"

endchoice

config BME68X_IAQ_LOG_LEVEL
	int
	depends on LOG
	default 0 if BME68X_IAQ_LOG_LEVEL_OFF
	default 1 if BME68X_IAQ_LOG_LEVEL_ERR
	default 2 if BME68X_IAQ_LOG_LEVEL_WRN
	default 3 if BME68X_IAQ_LOG_LEVEL_INF
	default 4 if BME68X_IAQ_LOG_LEVEL_DBG
	default LOG_DEFAULT_LEVEL if BME68X_IAQ_LOG_LEVEL_DEFAULT

endif # BME68X_IAQ
```

## lib/bme68x-iaq/boards/nrf52840dk_nrf52840-settings.conf
```kconfig
# SPDX-License-Identifier: Apache-2.0

# Enable BSEC state persistence to per-device settings.
#
CONFIG_BME68X_IAQ_SETTINGS=y
CONFIG_SETTINGS=y
CONFIG_SETTINGS_NVS=y

CONFIG_NVS=y
CONFIG_FLASH=y
CONFIG_FLASH_MAP=y
CONFIG_MPU_ALLOW_FLASH_WRITE=y

# Troubleshoot NVS.
CONFIG_NVS_LOG_LEVEL_DBG=y
CONFIG_FLASH_LOG_LEVEL_DBG=y
```

## lib/bme68x-sensor-api/Kconfig
```kconfig
# Copyright (c) 2024, Chris Duf
#
# SPDX-License-Identifier: Apache-2.0

menuconfig BME68X_SENSOR_API
	bool "BME68X Sensor API"
	help
	  Enable Bosch Sensortec's BME68X Sensor API library.

	  Version 4.4.8.

	  Copyright (c) 2023 Bosch Sensortec GmbH. All rights reserved.
	  License: BSD-3-Clause

	  See https://github.com/boschsensortec/BME68x_SensorAPI

if BME68X_SENSOR_API

config BME68X_SENSOR_API_FLOAT
	bool "Floating point API"
	help
	  Enable the floating-point variant of the BME68X Sensor API.

	  Do not confuse with using hardware FPU and floating-point ABI.

endif # BME68X_SENSOR_API
```

## lib/bsec/Kconfig
```kconfig
# Copyright (c) 2024, Chris Duf
#
# SPDX-License-Identifier: Apache-2.0

config BSEC
	bool "Bosch Sensortec Environmental Cluster (BSEC)"
	help
	  Enable Bosch Sensortec Environmental Cluster (BSEC) library.

	  Header files and static libraries for Bosch Sensortec Environmental Cluster
	  (BSEC) Version 2.5.0.2.

	  License:
	  - library binaries (libalgobsec): Terms and Conditions for the use
	    of Bosch Sensortec’s BME680/BME688 Software
	  - C headers and configuration files: BSD-3-Clause license

	  See:
	  - https://www.bosch-sensortec.com/software-tools/software/bme680-software-bsec/
	  - https://github.com/boschsensortec/Bosch-BSEC2-Library/blob/master/LICENSE.md

# $ZEPHYR_BASE/cmake/modules/extensions.cmake:
#
# Zephyr libraries must explicitly call
# zephyr_library_link_libraries(<interface_library>) to use this build
# information. 'app' is treated as a special case for usability
# reasons; a Kconfig option (CONFIG_APP_LINK_WITH_<interface_library>)
# should exist for each interface_library and will determine if 'app'
# links with the interface_library.
config APP_LINK_WITH_BSEC
	bool
	depends on BSEC
	default y
	help
	  Link Zephyr application with BSEC2 library.
```
